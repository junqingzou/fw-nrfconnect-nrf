## CMakeLists.txt
```
#
# Copyright (c) 2018 Nordic Semiconductor
#
# SPDX-License-Identifier: LicenseRef-BSD-5-Clause-Nordic
#

cmake_minimum_required(VERSION 3.13.1)

find_package(Zephyr REQUIRED HINTS $ENV{ZEPHYR_BASE})
project(ftp-speed-test)

# NORDIC SDK APP START
target_sources(app PRIVATE src/main.c)
# NORDIC SDK APP END
```

## sample.yaml
```
sample:
  name: ftp speed test sample
tests:
  samples.nrf9160.ftp_speed_test:
    build_only: true
    build_on_all: true
    platform_whitelist: nrf9160dk_nrf9160ns
    tags: ci_build
```

## prj.conf
```kconfig
#
# Copyright (c) 2019 Nordic Semiconductor ASA
#
# SPDX-License-Identifier: LicenseRef-BSD-5-Clause-Nordic
#

# Networking
CONFIG_NETWORKING=y
CONFIG_NET_NATIVE=n
CONFIG_NET_SOCKETS_OFFLOAD=y
CONFIG_NET_SOCKETS=y
CONFIG_NET_SOCKETS_POSIX_NAMES=y

# LTE link control
CONFIG_LTE_LINK_CONTROL=y
CONFIG_LTE_AUTO_INIT_AND_CONNECT=n

# BSD library
CONFIG_BSD_LIBRARY=y

# AT Host
CONFIG_UART_INTERRUPT_DRIVEN=y
CONFIG_AT_HOST_LIBRARY=y

# FTP
CONFIG_FTP_CLIENT=y

# Appliaction

# Main thread
CONFIG_MAIN_STACK_SIZE=4096

CONFIG_HEAP_MEM_POOL_SIZE=2048
```

## src/main.c
```c
/*
 * Copyright (c) 2018 Nordic Semiconductor ASA
 *
 * SPDX-License-Identifier: LicenseRef-BSD-5-Clause-Nordic
 */

#include <zephyr.h>
#include <stdio.h>
//include <drivers/uart.h>
#include <string.h>
#include <net/mqtt.h>
#include <net/socket.h>
#include <net/ftp_client.h>
#include <modem/lte_lc.h>

#define HOST_NAME	"speedtest.tele2.net"
#define FTP_PORT	21
#define USER_NAME	"anonymous"
#define USER_PASSWORD	"anonymous@example.com"
#define SEC_TAG		-1

#define TARGET_FILE	"1MB.zip"
#define TARGET_SIZE	1024*1024

static uint64_t start_time, now_time;
static bool first_data_received;
static int bytes_received;
static K_SEM_DEFINE(rx_done, 0, 1);

#if defined(CONFIG_BSD_LIBRARY)

/**@brief Recoverable BSD library error. */
void bsd_recoverable_error_handler(uint32_t err)
{
	printk("bsdlib recoverable error: %u\n", (unsigned int)err);
}

#endif /* defined(CONFIG_BSD_LIBRARY) */

/**@brief Configures modem to provide LTE link. Blocks until link is
 * successfully established.
 */
static void modem_configure(void)
{
#if defined(CONFIG_LTE_LINK_CONTROL)
	if (IS_ENABLED(CONFIG_LTE_AUTO_INIT_AND_CONNECT)) {
		/* Do nothing, modem is already turned on
		 * and connected.
		 */
	} else {
		int err;

		printk("LTE Link Connecting ...\n");
		err = lte_lc_init_and_connect();
		__ASSERT(err == 0, "LTE link could not be established.");
		printk("LTE Link Connected!\n");
	}
#endif /* defined(CONFIG_LTE_LINK_CONTROL) */
}

void ftp_ctrl_callback(const uint8_t *msg, uint16_t len)
{
	printk("%s", (char *)msg);
}

void ftp_data_callback(const uint8_t *msg, uint16_t len)
{
	now_time = k_uptime_get();
	if (!first_data_received) {
		start_time = now_time;
		first_data_received = true;
	}
	printk("[%08d] %d bytes received\n", (int)(now_time - start_time), len);
	bytes_received += len;
	if (bytes_received >= TARGET_SIZE) {
		now_time = k_uptime_delta(&start_time);
		printk("done, run-time: %d ms\n", (int)now_time);
		k_sem_give(&rx_done);
	}
}

void main(void)
{
	int ret;

	printk("FTP speed test sample started\n");

	modem_configure();
	ftp_init(ftp_ctrl_callback, ftp_data_callback);

	/* FTP open */
	ret = ftp_open(HOST_NAME, FTP_PORT, SEC_TAG);
	if (ret != FTP_CODE_200) {
		printk("ftp_open error %d", ret);
		return;
	}
	/* FTP login */
	ret = ftp_login(USER_NAME, USER_PASSWORD);
	if (ret != FTP_CODE_230) {
		printk("ftp_login error %d", ret);
		ftp_close();
		return;
	}
#if 0
	/* FTP list*/
	ret = ftp_list("-l", TARGET_FILE);
	if (ret != FTP_CODE_226) {
		printk("ftp_list error %d", ret);
		ftp_close();
		return;
	}
#endif
	/* FTP get */
	first_data_received = false;
	ftp_get(TARGET_FILE);
	k_sem_take(&rx_done, K_FOREVER);
	ftp_close();
	k_sleep(K_SECONDS(1));
	lte_lc_power_off();
	int total_time = (now_time + 500) / 1000;
	int total_bits = bytes_received * 8;
	printk("============================\n");
	printk("time:\t\t%d sec\n", total_time);
	printk("size:\t\t%d bits\n", total_bits);
	printk("throughput:\t%d bps\n", total_bits / total_time);
}
```
