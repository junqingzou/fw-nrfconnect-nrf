## CMakeLists.txt
```
#
# Copyright (c) 2019 Nordic Semiconductor
#
# SPDX-License-Identifier: LicenseRef-BSD-5-Clause-Nordic
#

cmake_minimum_required(VERSION 3.8.2)

# This sample runs as a non-secure application on nRF91. Therefore, it
# requires the secure_partition_manager that prepares the required
# peripherals to be available for the application.
#
# Configure the SPM image to enable the peripherals that this sample
# needs.
set(spm_CONF_FILE
  prj.conf
  ${CMAKE_CURRENT_LIST_DIR}/child_secure_partition_manager.conf
  )

include($ENV{ZEPHYR_BASE}/cmake/app/boilerplate.cmake NO_POLICY_SCOPE)
project(serial_lte_modem)

target_sources(app PRIVATE src/main.c)
target_sources(app PRIVATE src/elp_connect.c)
target_sources(app PRIVATE src/elp_util.c)
target_sources_ifdef(CONFIG_ELP_TEST app PRIVATE src/elp_test.c)
add_subdirectory(src/modem)
add_subdirectory(src/lwm2m)

zephyr_include_directories(src)
```

## Kconfig
```
#
# Copyright (c) 2019 Nordic Semiconductor
#
# SPDX-License-Identifier: LicenseRef-BSD-5-Clause-Nordic
#

source "$ZEPHYR_BASE/Kconfig.zephyr"

menu "Eureka LwM2M Proxy"

config EUREKA_LWM2M_PROXY
	bool "Eureka LwM2M Proxy"
	default y
	select LTE_LINK_CONTROL
	select MODEM_INFO

#
# Inter-Connect
#
choice
	prompt "UART for Interconnect"
	default INTER_CONNECT_UART_2
	help
		Sets the UART to use for interconnect
		-  UART 0
		-  UART 1
		-  UART 2
	config INTER_CONNECT_UART_0
		bool "UART 0"
	config INTER_CONNECT_UART_1
		bool "UART 1"
	config INTER_CONNECT_UART_2
		bool "UART 2"
endchoice

config INTER_CONNECT_UART
	int
	default 0 if INTER_CONNECT_UART_0
	default 1 if INTER_CONNECT_UART_1
	default 2 if INTER_CONNECT_UART_2

config INTER_CONNECT_UART_BUF_SIZE
	int "UART buffer size"
	default 256
	help
	  "Protocol packet size, max 256"

config INTER_CONNECT_BCC
	bool "Inter_Connect BCC"
	default n
	help
	  "Enable/Disable Block Check Code (BCC)"

#
# GPIO wakeup
#
config ELP_GPIO_WAKEUP
	bool "Support of GPIO wakeup"
	help
	  Enable GPIO wakeup on nRF9160 side

if ELP_GPIO_WAKEUP
config ELP_MODEM_WAKEUP_PIN
	int "GPIO for wakeup"
	default 31
endif # ELP_GPIO_WAKEUP

# LwM2M service
rsource "src/lwm2m/Kconfig"

# nRF91 local test harness
config ELP_TEST
	bool "nRF91 local test harness"
	help
	  Enable local test harness

module = ELP
module-str = ELP
source "${ZEPHYR_BASE}/subsys/logging/Kconfig.template.log_config"

endmenu
```

## prj.conf
```kconfig
#
# Copyright (c) 2019 Nordic Semiconductor ASA
#
# SPDX-License-Identifier: LicenseRef-BSD-5-Clause-Nordic
#
# General config
CONFIG_TEST_RANDOM_GENERATOR=y
CONFIG_LOG=y
CONFIG_LOG_DEFAULT_LEVEL=3

# Network
CONFIG_NETWORKING=y
CONFIG_NET_SOCKETS=y
CONFIG_DNS_RESOLVER=y
CONFIG_NET_NATIVE=n
CONFIG_NET_IPV4=y
CONFIG_NET_IPV6=n

# BSD library
CONFIG_BSD_LIBRARY=y
CONFIG_BSD_LIBRARY_TRACE_ENABLED=y

# Use GPIO
CONFIG_GPIO=y
CONFIG_GPIO_NRFX=y
CONFIG_GPIO_NRF_INIT_PRIORITY=40
CONFIG_GPIO_NRF_P0=y

# UART interface
CONFIG_SERIAL=y
CONFIG_UART_INTERRUPT_DRIVEN=y
CONFIG_UART_2_NRF_UARTE=y
CONFIG_UART_2_NRF_FLOW_CONTROL=y

# Stacks and heaps
CONFIG_MAIN_THREAD_PRIORITY=7
CONFIG_MAIN_STACK_SIZE=4096
CONFIG_HEAP_MEM_POOL_SIZE=16384

# LTE link control
CONFIG_LTE_AUTO_INIT_AND_CONNECT=n
CONFIG_LTE_NETWORK_MODE_LTE_M=y

# LwM2M lib
CONFIG_LWM2M=y
CONFIG_LWM2M_COAP_BLOCK_SIZE=512
CONFIG_LWM2M_LOG_LEVEL_INF=y
CONFIG_LWM2M_RD_CLIENT_SUPPORT_BOOTSTRAP=n
CONFIG_LWM2M_FIRMWARE_UPDATE_OBJ_SUPPORT=n
CONFIG_LWM2M_ENGINE_DEFAULT_LIFETIME=30
CONFIG_LWM2M_PEER_PORT=5683
CONFIG_LWM2M_ENGINE_DEFAULT_LIFETIME=180
CONFIG_LWM2M_ADC_OBJ_SUPPORT=y

# Device power management
CONFIG_DEVICE_POWER_MANAGEMENT=y

# Application-specific
CONFIG_ELP_GPIO_WAKEUP=y
CONFIG_ELP_LOG_LEVEL_INF=y
CONFIG_ELP_LWM2M_SERVER="3.1.247.27"
CONFIG_ELP_TEST=n

CONFIG_LTE_PDP_CMD=y
CONFIG_LTE_PDP_CONTEXT="0,\"IPV4V6\",\"tiot05\""
CONFIG_LTE_PDN_AUTH_CMD=y
CONFIG_LTE_PDN_AUTH="0,1,\"plusw6q9tattkmpk\",\"msfbbam83bsdetxb\""
```

## src/main.c
```c
/*
 * Copyright (c) 2019 Nordic Semiconductor ASA
 *
 * SPDX-License-Identifier: LicenseRef-BSD-5-Clause-Nordic
 */
#include <logging/log.h>

#include <zephyr.h>
#include <stdio.h>
#include <string.h>
#include <init.h>
#include <bsd.h>
#include <lte_lc.h>
#include <modem_info.h>

#include <hal/nrf_gpio.h>
#include <hal/nrf_power.h>
#include <hal/nrf_regulators.h>

#include "elp_connect.h"
#include "elp_modem_service.h"
#include "elp_lwm2m_service.h"
#if defined(CONFIG_ELP_TEST)
#include "elp_test.h"
#endif

LOG_MODULE_REGISTER(app, CONFIG_ELP_LOG_LEVEL);

/* global variable used across different files */
struct modem_param_info modem_param;

void enter_sleep(void);

/**@brief UART RX data handling */
static void data_handler(u8_t cmd_type, const u8_t *data_buf, u8_t data_len)
{
	if (cmd_type == CMD_TYPE_DATA) {
		LOG_INF("%s", log_strdup(data_buf));
		/* Echo back data for UART testing. */
		(void)inter_connect_send(CMD_TYPE_DATA, "nRF91 ready", 11);
	}
#if defined(CONFIG_ELP_GPIO_WAKEUP)
	else if (cmd_type == (RSP_TYPE_BASE|CMD_TYPE_SYNC_CMD)) {
		LOG_INF("Sync up");
	}
	else if (cmd_type == CMD_TYPE_SLEEP_CMD) {
		th_lwm2m_control(CMD_TYPE_LWM2M_DISCONNECT, NULL, 0);
		k_sleep(1000);  //TBD
		inter_connect_uninit();
		enter_sleep();
	}
#endif
	else if ((cmd_type & 0xF0) == CMD_TYPE_MDM_BASE) {
		th_modem_control(cmd_type, data_buf);
	}
	else if ((cmd_type & 0xF0) == CMD_TYPE_LWM2M_BASE) {
		th_lwm2m_control(cmd_type, data_buf, data_len);
	}
	else {
		LOG_WRN("unknown data, dropped");
	}
}

/**@brief Recoverable BSD library error. */
void bsd_recoverable_error_handler(uint32_t err)
{
	LOG_ERR("bsdlib recoverable error: %u", err);
}

void start_execute(void)
{
	int err;

#if !defined(CONFIG_ELP_TEST)
	/* Initialize the inter connect library. */
	err = inter_connect_init(data_handler);
	if (err) {
		LOG_ERR("Init inter_connect error: %d", err);
		return;
	}
#endif /* CONFIG_ELP_TEST*/

	LOG_INF("Network service proxy starts");
	LOG_INF(" .Modem control");
	LOG_INF(" .LwM2M service");

	err = modem_info_init();
	if (err) {
		LOG_ERR("Modem info could not be established: %d", err);
		return;
	}

	modem_info_params_init(&modem_param);

#if !defined(CONFIG_ELP_TEST)
	/* Signal peer that nRF91 is ready */
	(void)inter_connect_send(CMD_TYPE_SYNC_CMD, NULL, 0);
#else
	th_test_main();
#endif	/* CONFIG_ELP_TEST */
}

#ifdef CONFIG_ELP_GPIO_WAKEUP
void enter_sleep(void)
{
	/*
	 * Due to errata 4, Always configure PIN_CNF[n].INPUT before
	 *  PIN_CNF[n].SENSE.
	 */
	nrf_gpio_cfg_input(CONFIG_ELP_MODEM_WAKEUP_PIN,
		NRF_GPIO_PIN_PULLUP);
	nrf_gpio_cfg_sense_set(CONFIG_ELP_MODEM_WAKEUP_PIN,
		NRF_GPIO_PIN_SENSE_LOW);

	/*
	 * The LTE modem also needs to be stopped by issuing a command
	 * through the modem API, before entering System OFF mode.
	 * Once the command is issued, one should wait for the modem
	 * to respond that it actually has stopped as there may be a
	 * delay until modem is disconnected from the network.
	 * Refer to https://infocenter.nordicsemi.com/topic/ps_nrf9160/
	 * pmu.html?cp=2_0_0_4_0_0_1#system_off_mode
	 */
	lte_lc_power_off();	/* Gracefully shutdown the modem.*/
	bsd_shutdown();		/* Gracefully shutdown the BSD library*/
	nrf_regulators_system_off(NRF_REGULATORS_NS);
}

void main(void)
{
	u32_t rr = nrf_power_resetreas_get(NRF_POWER_NS);

	LOG_DBG("RR: 0x%08x", rr);
	if (rr & NRF_POWER_RESETREAS_OFF_MASK) {
		nrf_power_resetreas_clear(NRF_POWER_NS, 0x70017);
		start_execute();
	} else {
		LOG_INF("Sleep");
		enter_sleep();
	}
}
#else
void main(void)
{
	start_execute();
}
#endif	/* CONFIG_ELP_GPIO_WAKEUP */
```

## src/elp_connect.c
```c
/*
 * Copyright (c) 2019 Nordic Semiconductor ASA
 *
 * SPDX-License-Identifier: LicenseRef-BSD-5-Clause-Nordic
 */
#include <logging/log.h>
#include <zephyr.h>
#include <stdio.h>
#include <string.h>
#include <drivers/uart.h>

#include "elp_connect.h"

#define CONFIG_UART_0_NAME	 "UART_0"
#define CONFIG_UART_1_NAME	 "UART_1"
#define CONFIG_UART_2_NAME	 "UART_2"

LOG_MODULE_REGISTER(conn, CONFIG_ELP_LOG_LEVEL);

/**
 * Data packet format
 * [STX(1)][TYPE(1)][LENGTH(1)][VALUE(vary)][BCC(1)]
 */
#define PROT_HEADER_STX		0x02	/** STX char */
#define PROT_HEADER_LEN		3	/** [STX][TYPE][LENGTH]*/
#define PROT_STX_POS		0	/** Position of STX byte */
#define PROT_TYP_POS		1	/** Position of Type byte */
#define PROT_LEN_POS		2	/** Position of Length byte */

/** @brief UARTs. */
enum select_uart {
	UART_0,
	UART_1,
	UART_2
};

static data_handler_t data_handler_cb;
static struct device *uart_dev;
static u8_t rx_buff[CONFIG_INTER_CONNECT_UART_BUF_SIZE];
static u8_t tx_buff[CONFIG_INTER_CONNECT_UART_BUF_SIZE];
static bool module_initialized;

static struct k_work rx_data_handle_work;

static void rx_data_handle(struct k_work *work)
{
	ARG_UNUSED(work);

	if (data_handler_cb == NULL) {
		LOG_ERR("Not itialized");
		return;
	}

	LOG_HEXDUMP_DBG(rx_buff, (rx_buff[PROT_LEN_POS]+PROT_HEADER_LEN+1),
		"RX");

	if (rx_buff[PROT_STX_POS] != PROT_HEADER_STX) {
		LOG_ERR("Missing STX");
		return;
	}
#if CONFIG_INTER_CONNECT_BCC
	{
		u8_t bcc = 0xff;
		u8_t *ptr = &rx_buff[PROT_LEN_POS+1];
		size_t i;

		for (i = PROT_TYP_POS; i < (rx_buff[PROT_LEN_POS]-1); i++) {
			bcc ^= *ptr;
			ptr++;
		}
		if (bcc != *ptr) {
			LOG_ERR("BCC error");
			return;
		}
	}
#endif	/* CONFIG_INTER_CONNECT_BCC */

	data_handler_cb(rx_buff[PROT_TYP_POS],
			&rx_buff[PROT_LEN_POS+1],
			rx_buff[PROT_LEN_POS]);
	uart_irq_rx_enable(uart_dev);
}

static void uart_rx_handler(u8_t character)
{
	static size_t pkt_length;
	static size_t cmd_len;
	size_t pos;

	pos = cmd_len;
	cmd_len += 1;
	if (pos == PROT_LEN_POS) {
		pkt_length = character;
	}

	/* Detect buffer overflow or zero length */
	if (cmd_len > CONFIG_INTER_CONNECT_UART_BUF_SIZE) {
		LOG_ERR("Buffer overflow, dropping '%c'", character);
		cmd_len = CONFIG_INTER_CONNECT_UART_BUF_SIZE;
		return;
	} else if (cmd_len < 1) {
		LOG_ERR("Invalid packet length: %d", cmd_len);
		cmd_len = 0;
		return;
	}

	rx_buff[pos] = character;

	/* Check if all packet is received. */
	if (pos == (PROT_LEN_POS + pkt_length + 1)) {
		goto send;
	}
	return;

send:
	uart_irq_rx_disable(uart_dev);
	k_work_submit(&rx_data_handle_work);
	cmd_len = 0;
	pkt_length = 0;
}

static void if_isr(struct device *dev)
{
	u8_t character;

	uart_irq_update(dev);

	if (uart_irq_rx_ready(dev)) {
		/* keep reading until drain all */
		while (uart_fifo_read(dev, &character, 1)) {
			uart_rx_handler(character);
		}
	}
}

static int if_uart_init(char *uart_dev_name)
{
	int err;

	uart_dev = device_get_binding(uart_dev_name);
	if (uart_dev == NULL) {
		LOG_ERR("Cannot bind %s", uart_dev_name);
		return -EINVAL;
	}
	err = uart_err_check(uart_dev);
	if (err) {
		LOG_WRN("UART check failed: %d", err);
	}
	uart_irq_callback_set(uart_dev, if_isr);
	return 0;
}

int inter_connect_init(data_handler_t data_handler)
{
	char *uart_dev_name;
	int err;
	enum select_uart uart_id = CONFIG_INTER_CONNECT_UART;

	if (data_handler == NULL) {
		LOG_ERR("Data handler is null");
		return -EINVAL;
	}
	data_handler_cb = data_handler;

	/* Choose which UART to use */
	switch (uart_id) {
	case UART_0:
		uart_dev_name = CONFIG_UART_0_NAME;
		break;
	case UART_1:
		uart_dev_name = CONFIG_UART_1_NAME;
		break;
	case UART_2:
		uart_dev_name = CONFIG_UART_2_NAME;
		break;
	default:
		LOG_ERR("Unknown UART instance %d", uart_id);
		return -EINVAL;
	}

	/* Initialize the UART module */
	err = if_uart_init(uart_dev_name);
	if (err) {
		LOG_ERR("UART could not be initialized: %d", err);
		return -EFAULT;
	}

	k_work_init(&rx_data_handle_work, rx_data_handle);
	memset(rx_buff, 0x00, CONFIG_INTER_CONNECT_UART_BUF_SIZE);
	uart_irq_rx_enable(uart_dev);
	module_initialized = true;
	return err;
}

int inter_connect_uninit(void)
{
	int err = 0;

#if defined(CONFIG_DEVICE_POWER_MANAGEMENT)
	err = device_set_power_state(uart_dev, DEVICE_PM_OFF_STATE,
				NULL, NULL);
	if (err != 0) {
		LOG_WRN("Can't power off uart err=%d", err);
	}
#endif
	return 0;
}

int inter_connect_send(u8_t type, const u8_t *data_buff, u8_t data_len)
{
	u32_t pkt_size = data_len + PROT_HEADER_LEN + 1;

	if (!module_initialized) {
		return -EACCES;
	}

	if (pkt_size > CONFIG_INTER_CONNECT_UART_BUF_SIZE) {
		LOG_ERR("Message size error");
		return -EINVAL;
	}

	/* Assemble the protocol message */
	memset(tx_buff, 0x00, CONFIG_INTER_CONNECT_UART_BUF_SIZE);
	tx_buff[PROT_STX_POS] = PROT_HEADER_STX;
	tx_buff[PROT_TYP_POS] = type;
	tx_buff[PROT_LEN_POS] = data_len;
	if (data_buff != NULL) {
		memcpy(&tx_buff[PROT_LEN_POS+1], data_buff, data_len);
	}

	LOG_HEXDUMP_DBG(tx_buff, pkt_size, "TX");
	/* Forward the data over UART if any. */
	/* Poll out what is in the buffer gathered from the modem. */
	for (size_t i = 0; i < pkt_size; i++) {
		uart_poll_out(uart_dev, tx_buff[i]);
	}

	return 0;
}

int inter_connect_notify(u8_t type, const u8_t *data_buff, u8_t data_len)
{
	u32_t pkt_size = data_len + PROT_HEADER_LEN + 2;

	if (!module_initialized) {
		return -EACCES;
	}

	if (pkt_size > CONFIG_INTER_CONNECT_UART_BUF_SIZE) {
		LOG_ERR("Message size error");
		return -EINVAL;
	}

	/* Assemble the protocol message */
	memset(tx_buff, 0x00, CONFIG_INTER_CONNECT_UART_BUF_SIZE);
	tx_buff[PROT_STX_POS] = PROT_HEADER_STX;
	tx_buff[PROT_TYP_POS] = RSP_TYPE_NOTIFICATION;
	tx_buff[PROT_LEN_POS] = data_len+1;
	tx_buff[PROT_LEN_POS+1] = type;
	if (data_buff != NULL) {
		memcpy(&tx_buff[PROT_LEN_POS+2], data_buff, data_len);
	}

	LOG_HEXDUMP_DBG(tx_buff, pkt_size, "TX");
	/* Forward the data over UART if any. */
	/* Poll out what is in the buffer gathered from
	 * the modem.
	 */
	for (size_t i = 0; i < pkt_size; i++) {
		uart_poll_out(uart_dev, tx_buff[i]);
	}

	return 0;
}
```

## src/elp_connect.h
```c
/*
 * Copyright (c) 2019 Nordic Semiconductor ASA
 *
 * SPDX-License-Identifier: LicenseRef-BSD-5-Clause-Nordic
 */

#ifndef ELP_CONNECT_H_
#define ELP_CONNECT_H_

/**@file elp_connect.h
 *
 * @brief nRF52/nRF91 inter-connect protocol.
 * @{
 */

#include <stdlib.h>
#include <zephyr/types.h>

/** Command type. */
enum ic_cmd_type {
	/** Arbitrary data. */
	CMD_TYPE_DATA = 0x00,
	/** Generic commands service. */
	CMD_TYPE_GENERIC_BASE = 0x01,
	CMD_TYPE_SYNC_CMD = CMD_TYPE_GENERIC_BASE,
	CMD_TYPE_SLEEP_CMD,
	/** Modem control service */
	CMD_TYPE_MDM_BASE = 0x10,
	CMD_TYPE_MDM_INT_CONNECT = CMD_TYPE_MDM_BASE,
	CMD_TYPE_MDM_GO_OFFLINE,
	CMD_TYPE_MDM_POWER_OFF,
	CMD_TYPE_MDM_GO_ONLINE,
	CMD_TYPE_MDM_PSM_REQ,
	CMD_TYPE_MDM_EDRX_REQ,
	/** LWM2M service **/
	CMD_TYPE_LWM2M_BASE = 0x20,
	CMD_TYPE_LWM2M_CONNECT = CMD_TYPE_LWM2M_BASE,
	CMD_TYPE_LWM2M_DISCONNECT,
	CMD_TYPE_LWM2M_SET_PATH,
	CMD_TYPE_LWM2M_READ_INT,
	CMD_TYPE_LWM2M_WRITE_INT,
	CMD_TYPE_LWM2M_READ_FLOAT,
	CMD_TYPE_LWM2M_WRITE_FLOAT,
	CMD_TYPE_LWM2M_READ_STRING,
	CMD_TYPE_LWM2M_WRITE_STRING,
	CMD_TYPE_LWM2M_READ_OPAQUE,
	CMD_TYPE_LWM2M_WRITE_OPAQUE,
	/** Type reserved. */
	CMD_TYPE_RESERVED = 0x7F,
	/** Type response base. */
	RSP_TYPE_BASE = 0x80,
	/** Type unsocilicted notification */
	RSP_TYPE_NOTIFICATION = 0xFF
};

/** Unsolicited notification type. */
enum ic_notify_type {
	NOT_TYPE_BASE = 0x00,
	/** Notification type LwM2M */
	NOT_TYPE_LWM2M_RD,	/* Registration and discovery events */
	NOT_TYPE_LWM2M_OBJECT,	/* LwM2M Object events */
	NOT_TYPE_LWM2M_NOTIFY_RESULT,	/* LwM2M Notify result events */
	NOT_TYPE_INVALID
};

/**
 * @typedef data_handler_t
 * @brief Callback when data is received from inter_connect interface.
 *
 * @param data_type Type of data, see ic_cmd_type.
 * @param data_buf Data buffer.
 * @param data_len Length of data buffer.
 */
typedef void (*data_handler_t)(u8_t data_type, const u8_t *data_buf,
				u8_t data_len);

/** @brief Initialize the library.
 *
 * @param data_handler Callback handler for received data.
 *
 * @retval 0 If the operation was successful.
 *	Otherwise, a (negative) error code is returned.
 */
int inter_connect_init(data_handler_t data_handler);

/** @brief Uninitialize the library.
 *
 * @retval 0 If the operation was successful.
 *	Otherwise, a (negative) error code is returned.
 */
int inter_connect_uninit(void);

/** @brief Send data or command response to the peer.
 *
 * @param data_type Type of response, see ic_cmd_type.
 * @param data_buf Data buffer.
 * @param data_len Length of data buffer.
 *
 * @retval 0 If the operation was successful.
 *	Otherwise, a (negative) error code is returned.
 */
int inter_connect_send(u8_t type, const u8_t *data_buf, u8_t data_len);

/** @brief Send unsolicited response to the peer.
 *
 * @param data_type Type of notification, see ic_notify_type.
 * @param data_buf Data buffer.
 * @param data_len Length of data buffer.
 *
 * @retval 0 If the operation was successful.
 *	Otherwise, a (negative) error code is returned.
 */
int inter_connect_notify(u8_t type, const u8_t *data_buf, u8_t data_len);

/** @} */

#endif /* ELP_CONNECT_H_ */
```

## src/elp_test.c
```c
/*
 * Copyright (c) 2019 Nordic Semiconductor ASA
 *
 * SPDX-License-Identifier: LicenseRef-BSD-5-Clause-Nordic
 */
#include <logging/log.h>
#include <zephyr.h>
#include <stdio.h>
#include <string.h>
#include <modem_info.h>

#include "elp_test.h"
#include "elp_connect.h"
#include "elp_modem_service.h"
#include "elp_lwm2m_service.h"

LOG_MODULE_REGISTER(test, CONFIG_ELP_LOG_LEVEL);

#if defined(CONFIG_ELP_TEST) && defined(CONFIG_ELP_GPIO_WAKEUP)
#error ELP_GPIO_WAKEUP cannot be defined when ELP_TEST is defined
#endif

static struct k_work lte_lc_work;
static K_SEM_DEFINE(lte_connected, 0, 1);

/* global variable defined in different files */
extern struct modem_param_info modem_param;

static void lte_lc_connect(struct k_work *work)
{
	ARG_UNUSED(work);
	th_modem_control(CMD_TYPE_MDM_INT_CONNECT, NULL);
}

void th_test_lte_callback(int result)
{
	if (result == 0) {
		k_sem_give(&lte_connected);
	}
}

void th_test_main(void)
{
	LOG_INF("Start testing");
	k_work_init(&lte_lc_work, lte_lc_connect);
	k_work_submit(&lte_lc_work);
	k_sem_take(&lte_connected, K_FOREVER);

	/* Test SNTP */
	/* Test LwM2M connection */
	th_lwm2m_control(CMD_TYPE_LWM2M_CONNECT, NULL, 0);
}
```

## src/elp_test.h
```c
/*
 * Copyright (c) 2019 Nordic Semiconductor ASA
 *
 * SPDX-License-Identifier: LicenseRef-BSD-5-Clause-Nordic
 */

#ifndef ELP_TEST_
#define ELP_TEST_

/**@file elp_test.h
 *
 * @brief test functions for eureka lwm2m proxy
 * @{
 */

void th_test_lte_callback(int result);
void th_test_main(void);

/** @} */

#endif /* ELP_TEST_ */
```

## src/elp_util.c
```c
/*
 * Copyright (c) 2019 Nordic Semiconductor ASA
 *
 * SPDX-License-Identifier: LicenseRef-BSD-5-Clause-Nordic
 */
#include <logging/log.h>
#include <zephyr.h>
#include <stdio.h>
#include <string.h>

#include <net/socket.h>

LOG_MODULE_REGISTER(util, CONFIG_ELP_LOG_LEVEL);

/**@brief Resolves host IPv4 address and port
 */
bool util_check_for_ipv4(const char *address, u8_t length)
{
	int index;

	for (index = 0; index < length; index++) {
		char ch = *(address + index);
		if ( (ch == '.') || (ch >= '0' && ch <= '9')) {
			continue;
		} else {
			return false;
		}
	}

	return true;
}

/**@brief Resolves host IPv4 address and port
 */
int util_parse_host_by_ipv4(const char *ip, u16_t port, void *socket_addr)
{
	struct sockaddr_in *server4 = ((struct sockaddr_in *)socket_addr);

	server4->sin_family = AF_INET;
	server4->sin_port = htons(port);
	LOG_INF("IPv4 Address %s", log_strdup(ip));
	/* NOTE inet_pton() returns 1 as success */
	if (inet_pton(AF_INET, ip, &server4->sin_addr) == 1) {
		return 0;
	} else {
		return -EINVAL;
	}
}

/**@brief Resolves hostname and port
 */
int util_parse_host_by_name(const char *name, u16_t port, 
			enum net_sock_type socktype, void *socket_addr)
{
	int err;
	struct addrinfo *result;
	struct addrinfo hints = {
		.ai_family = AF_INET,
		.ai_socktype = socktype
	};
	char ipv4_addr[NET_IPV4_ADDR_LEN];

	err = getaddrinfo(name, NULL, &hints, &result);
	if (err) {
		LOG_ERR("ERROR: getaddrinfo failed %d", err);
		return err;
	}

	if (result == NULL) {
		LOG_ERR("ERROR: Address not found\n");
		return -ENOENT;
	}

	/* IPv4 Address. */
	struct sockaddr_in *server4 = ((struct sockaddr_in *)socket_addr);

	server4->sin_addr.s_addr =
		((struct sockaddr_in *)result->ai_addr)->sin_addr.s_addr;
	server4->sin_family = AF_INET;
	server4->sin_port = htons(port);

	inet_ntop(AF_INET, &server4->sin_addr.s_addr, ipv4_addr,
		  sizeof(ipv4_addr));
	LOG_DBG("IPv4 Address found %s\n", ipv4_addr);

	/* Free the address. */
	freeaddrinfo(result);

	return 0;
}
```

## src/elp_util.h
```c
/*
 * Copyright (c) 2019 Nordic Semiconductor ASA
 *
 * SPDX-License-Identifier: LicenseRef-BSD-5-Clause-Nordic
 */

#ifndef TH_UTIL_
#define TH_UTIL_

/**@file th_util.h
 *
 * @brief Common utility functions for serial LTE modem
 * @{
 */

/** @brief Check whether an remote address is IPv4 address of not.
 *
 * @param address Hostname or IPv4 address string.
 * @param length Length of the address string
 *
 * @retval true If the address is an IPv4 address.
 *	Otherwise, false is it's a hostname.
 */
bool util_check_for_ipv4(const char *address, u8_t length);

/** @brief Resolve IP address to socket address
 *
 * @param ip Remote IP Address string.
 * @param port Remote port number.
 * @param socket_addr Output of the resolved socket address.
 *
 * @retval 0 If the operation was successful.
 *	Otherwise, a (negative) error code is returned.
 */
int util_parse_host_by_ipv4(const char *ip, u16_t port, void *socket_addr);

/** @brief Resolve hostname to socket address
 *
 * @param ip Remote hostname string.
 * @param port Remote port number.
 * @param socket_addr Output of the resolved socket address.
 *
 * @retval 0 If the operation was successful.
 *	Otherwise, a (negative) error code is returned.
 */
int util_parse_host_by_name(const char *name, u16_t port,
			enum net_sock_type socktype, void *socket_addr);

/** @} */

#endif /* TH_UTIL_ */
```
